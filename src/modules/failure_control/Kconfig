## src/modules/failure_control/Kconfig
```kconfig
menuconfig MODULES_FAILURE_CONTROL
	bool "failure_control"
	default n
	---help---
		Enable support for failure_control

menuconfig USER_FAILURE_CONTROL
	bool "control_allocator running as userspace module"
	default y
	depends on BOARD_PROTECTED && MODULES_FAILURE_CONTROL
	---help---
		Put failure_control in userspace memory
```

## src/modules/failure_detection/Kconfig
```kconfig
menuconfig MODULES_FAILURE_DETECTION
	bool "failure_detection"
	default n
	---help---
		Enable support for failure_detection

menuconfig USER_FAILURE_DETECTION
	bool "control_allocator running as userspace module"
	default y
	depends on BOARD_PROTECTED && MODULES_FAILURE_DETECTION
	---help---
		Put failure_detection in userspace memory
```
